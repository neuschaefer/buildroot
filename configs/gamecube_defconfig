## configs/gamecube_defconfig
```kconfig
BR2_powerpc=y
BR2_powerpc_750=y
BR2_GCC_VERSION_6_X=y
BR2_ROOTFS_POST_IMAGE_SCRIPT="board/nintendo/gamecube/post-image.sh"
BR2_LINUX_KERNEL=y
BR2_LINUX_KERNEL_DEFCONFIG="gamecube"
BR2_LINUX_KERNEL_IMAGE_TARGET_CUSTOM=y
BR2_LINUX_KERNEL_IMAGE_TARGET_NAME="dtbImage.gamecube"
BR2_TARGET_ROOTFS_INITRAMFS=y
BR2_PACKAGE_HOST_GAMECUBE_TOOLS=y
```

## configs/wii_defconfig
```kconfig
BR2_powerpc=y
BR2_powerpc_750=y
BR2_ROOTFS_POST_IMAGE_SCRIPT="board/nintendo/wii/post-image.sh"
BR2_LINUX_KERNEL=y
BR2_LINUX_KERNEL_DEFCONFIG="wii"
BR2_LINUX_KERNEL_IMAGE_TARGET_CUSTOM=y
BR2_LINUX_KERNEL_IMAGE_TARGET_NAME="dtbImage.wii"
BR2_TARGET_ROOTFS_INITRAMFS=y
BR2_PACKAGE_HOST_GAMECUBE_TOOLS=y
```

## package/gamecube-tools/Config.in.host
```kconfig
config BR2_PACKAGE_HOST_GAMECUBE_TOOLS
	bool "host gamecube-tools"
	#depends on HOST_PACKAGE_LIBFREEIMAGE
	#depends on host C++
	help
	  This package contains several tools for use with a Nintendo
	  GameCube system:

	  * elf2dol: Converts an ELF file to a DOL file (the native
	             GameCube executable format)
	  * gcdsptool: TODO
	  * gxtexconv is not included, to avoid depending on libfreeimage

	  https://github.com/devkitPro/gamecube-tools/
```

## package/ldr-utils/Config.in.host
```kconfig
config BR2_PACKAGE_HOST_LDR_UTILS
	bool "host ldr-utils"
	help
	  Host utilities to deal with Blackfin bootstreams (in the LDR file
	  format).

	  https://github.com/neuschaefer/ldr-utils
```

## package/libobjfw/Config.in
```kconfig
config BR2_PACKAGE_LIBOBJFW
	bool "libobjfw"
	depends on BR2_TOOLCHAIN_BUILDROOT_OBJC
	help
	  ObjFW is a portable runtime for Objective-C.

	  https://heap.zone/objfw/

# TODO: Add more options
```

## package/micropython/Config.in
```kconfig
config BR2_PACKAGE_MICROPYTHON
	bool "micropython"
	depends on BR2_TOOLCHAIN_HAS_THREADS
	depends on !BR2_STATIC_LIBS
	select BR2_PACKAGE_LIBFFI
	help
	  Micro Python is a lean and fast implementation of the Python
	  3 programming language that is optimised to run on a
	  microcontroller.

	  http://micropython.org

config BR2_PACKAGE_MICROPYTHON_EXTRA_CFLAGS
	string "Additional micropython CFLAGS"
	depends on BR2_PACKAGE_MICROPYTHON
	help
	  Extra

comment "micropython needs a toolchain w/ threads, dynamic library"
	depends on !BR2_TOOLCHAIN_HAS_THREADS || BR2_STATIC_LIBS
```

## package/tipidee/Config.in
```kconfig
config BR2_PACKAGE_TIPIDEE
	bool "tipidee"
	depends on BR2_USE_MMU # skalibs
	select BR2_PACKAGE_SKALIBS
	help
	  tipidee is a web server. It supports HTTP 1.0 and 1.1. It aims
	  to be compliant with RFC 9112: while it only implements a very
	  limited subset of the optional functionality in HTTP 1.1, it
	  implements all the mandatory parts. It is usable with both
	  HTTP and HTTPS.

	  It runs under a super-server, e.g. inetd, s6-tcpserver, or
	  s6-tlsserver (for HTTPS). Traditionally, inetd-mode web
	  servers aren't considered performant, but tipidee aims to eke
	  out every single drop of performance that is attainable with
	  its programming model.

	  https://skarnet.org/software/tipidee/

if BR2_PACKAGE_TIPIDEE

config BR2_PACKAGE_TIPIDEE_CONFIGURATION
	bool "install a configuration file to /etc/tipidee.conf.cdb"
	select BR2_PACKAGE_HOST_TIPIDEE
	help
	  Build a tipidee configuration and install it to the target.

config BR2_PACKAGE_TIPIDEE_CONFIGURATION_FILE
	string "configuration source file"
	default "$(CONFIG_DIR)/tipidee.conf"
	depends on BR2_PACKAGE_TIPIDEE_CONFIGURATION
	help
	  The configuration file in source (text) format, documented at:

	  https://skarnet.org/software/tipidee/tipidee.conf.html

endif
```
